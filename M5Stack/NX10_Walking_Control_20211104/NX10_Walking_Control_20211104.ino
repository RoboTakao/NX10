#define M5STACK_MPU6886 
#include <M5Stack.h>
#include <ESP32Servo.h>    //ESPservo
#include <Wire.h>          // I2C setting
#include <PCA9685.h>       //PCA9685用ヘッダーファイル
#include "BluetoothSerial.h" //BluetoothSerial

BluetoothSerial SerialBT;

int angZero[] = {91,79,1,105,88,98,90,84,96,85,94,88,85,88,95,103,75,180};
int angHome[] = {-45,45,5,0,0,0,-48,76,28,0,0,-28,-76,48,0,0,0,-5};
//int angHome[] = {0,0,0,0,0,0,0,0,0,0,0,0,0,0,0,0,0,0};
int ang0[18];
int ang1[18];
int ang_b[18];
char ang_c[18];
int ts=20;
int td=5;

float roll, pitch, yaw;

// Forward Step
int f_s[40][18]={
  {-45,45,5,0,0,0,-48,76,28,0,0,-28,-76,48,0,0,0,-5},
  {-45,45,5,0,0,-5,-47,75,28,-5,-5,-28,-75,47,-5,0,0,-5},
  {-45,45,5,0,0,-8,-46,74,27,-8,-8,-27,-74,46,-8,0,0,-5},
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  {-45,45,5,0,0,0,-48,76,28,0,0,-28,-76,48,0,0,0,-5}};
// Left Step
int l_s[16][18]={
  {-45,45,0,0,0,0,-49,76,28,0,0,-28,-76,49,0,0,0,0},
  {-45,45,0,0,0,-8,-47,74,27,-8,-8,-27,-74,47,-8,0,0,0},
  {-45,45,0,0,0,-12,-45,71,27,-12,-12,-27,-71,45,-12,0,0,0},
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  {-45,45,0,0,0,0,-49,76,28,0,0,-28,-76,49,0,0,0,0}};
// Right Step
int r_s[16][18]={
  {-45,45,0,0,0,0,-49,76,28,0,0,-28,-76,49,0,0,0,0},
  {-45,45,0,0,0,8,-47,74,27,8,8,-27,-74,47,8,0,0,0},
  {-45,45,0,0,0,12,-45,71,27,12,12,-27,-71,45,12,0,0,0},
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  {-45,45,0,0,0,0,-49,76,28,0,0,-28,-76,49,0,0,0,0}};
// Back Step
int b_s[40][18]={
  {-45,45,5,0,0,0,-48,76,28,0,0,-28,-76,48,0,0,0,-5},
  {-45,45,5,0,0,-6,-47,74,28,-6,-6,-28,-74,47,-6,0,0,-5},
  {-45,45,5,0,0,-10,-45,73,27,-10,-10,-27,-73,45,-10,0,0,-5},
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  {-45,45,5,0,0,0,-48,76,28,0,0,-28,-76,48,0,0,0,-5}};
// Left Side Step
int ls_s[16][18]={
  {-45,45,0,0,0,0,-49,76,28,0,0,-28,-76,49,0,0,0,0},
  {-45,45,0,0,0,-5,-48,75,28,-5,-5,-28,-75,48,-5,0,0,0},
  {-45,45,0,0,0,-10,-46,72,27,-10,-10,-27,-72,46,-10,0,0,0},
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  {-45,45,0,0,0,0,-49,76,28,0,0,-28,-76,49,0,0,0,0}};
// Right Side Step
int rs_s[16][18]={
  {-45,45,0,0,0,0,-49,76,28,0,0,-28,-76,49,0,0,0,0},
  {-45,45,0,0,0,5,-48,75,28,5,5,-28,-75,48,5,0,0,0},
  {-45,45,0,0,0,10,-46,72,27,10,10,-27,-72,46,10,0,0,0},
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  {-45,45,0,0,0,0,-49,76,28,0,0,-28,-76,49,0,0,0,0}};
int delection = 0;

// create four servo objects (ESP32servo)
Servo servo3;
Servo servo4;

//PCA9685のアドレス指定
PCA9685 pwm = PCA9685(0x40);

// Published values for SG90 servos; adjust if needed (ESP32servo)
int minUs = 700;
int maxUs = 2300;

#define SERVOMIN 150            //最小パルス幅 (GWS Micro2BBMG) (PCA9685)
#define SERVOMAX 500            //最大パルス幅 (GWS Micro2BBMG) (PCA9685)

// These are all GPIO pins on the ESP32
// Recommended pins include 2,4,12-19,21-23,25-27,32-33
//int servo1Pin = 2;  //ESP32servo
//int servo2Pin = 5;  //ESP32servo 
int servo3Pin = 12;  //ESP32servo
int servo4Pin = 13;  //ESP32servo
//int servo5Pin = 16;  //ESP32servo
//int servo6Pin = 17;  //ESP32servo

int dt = ts/td;

void servo_write(int ch, int ang){ //動かすサーボチャンネルと角度を指定
  ang = map(ang, 0, 180, SERVOMIN, SERVOMAX); //角度（0～180）をPWMのパルス幅（150～500）に変換
  pwm.setPWM(ch, 0, ang);
}

void forward_step()
{
  for (int i=0; i <=39 ; i++){
    for (int j=0; j <=17 ; j++){
      ang1[j] = angZero[j] + f_s[i][j];
    }
  servo_set();
  }
}

void left_step()
{
  Left();
  for (int i=0; i <=15 ; i++){
    for (int j=0; j <=17 ; j++){
      ang1[j] = angZero[j] + l_s[i][j];
    }
  servo_set();
  }
  Center();
}

void right_step()
{
  Right();
  for (int i=0; i <=15 ; i++){
    for (int j=0; j <=17 ; j++){
      ang1[j] = angZero[j] + r_s[i][j];
    }
  servo_set();
  }
  Center();
}

void back_step()
{
  for (int i=0; i <=39 ; i++){
    for (int j=0; j <=17 ; j++){
      ang1[j] = angZero[j] + b_s[i][j];
    }
  servo_set();
  }
}

void left_side_step()
{
  Left();
  for (int i=0; i <=15 ; i++){
    for (int j=0; j <=17 ; j++){
      ang1[j] = angZero[j] + ls_s[i][j];
    }
  servo_set();
  }
  Center();
}

void right_side_step()
{
  Right();
  for (int i=0; i <=15 ; i++){
    for (int j=0; j <=17 ; j++){
      ang1[j] = angZero[j] + rs_s[i][j];
    }
  servo_set();
  }
  Center();
}

void Center() {
  M5.Lcd.fillRect(31, 95, 97, 49, YELLOW); //right eye
  M5.Lcd.fillRect(191, 95, 97, 49, YELLOW); //right eye
  M5.Lcd.fillCircle(79, 119, 24, BLACK); //right eye
  M5.Lcd.fillCircle(239, 119, 24, BLACK); //left eye
}

void Right() {
  M5.Lcd.fillRect(31, 95, 97, 49, YELLOW); //right eye
  M5.Lcd.fillRect(191, 95, 97, 49, YELLOW); //right eye
  M5.Lcd.fillCircle(55, 119, 24, BLACK); //right eye
  M5.Lcd.fillCircle(215, 119, 24, BLACK); //left eye
}

void Left() {
  M5.Lcd.fillRect(31, 95, 97, 49, YELLOW); //right eye
  M5.Lcd.fillRect(191, 95, 97, 49, YELLOW); //right eye
  M5.Lcd.fillCircle(103, 119, 24, BLACK); //right eye
  M5.Lcd.fillCircle(263, 119, 24, BLACK); //left eye
}

void servo_set()
{
  int a[18],b[18];
  
  for (int j=0; j <=17 ; j++){
      a[j] = ang1[j] - ang0[j];
      b[j] = ang0[j];
      ang0[j] = ang1[j];
  }

  for (int k=0; k <=td ; k++){

      // ESP32servo

      servo3.write(a[0]*(float)k/(float)td+b[0]);
      servo4.write(a[1]*(float)k/(float)td+b[1]);

      // PCA9685
      servo_write(0,a[2]*(float)k/(float)td+b[2]);
      servo_write(1,a[3]*(float)k/(float)td+b[3]);
      servo_write(2,a[4]*(float)k/(float)td+b[4]);
      servo_write(3,a[5]*(float)k/(float)td+b[5]);
      servo_write(4,a[6]*(float)k/(float)td+b[6]);
      servo_write(5,a[7]*(float)k/(float)td+b[7]);
      servo_write(6,a[8]*(float)k/(float)td+b[8]);
      servo_write(7,a[9]*(float)k/(float)td+b[9]);
      servo_write(8,a[10]*(float)k/(float)td+b[10]);
      servo_write(9,a[11]*(float)k/(float)td+b[11]);
      servo_write(10,a[12]*(float)k/(float)td+b[12]);
      servo_write(11,a[13]*(float)k/(float)td+b[13]);
      servo_write(12,a[14]*(float)k/(float)td+b[14]);
      servo_write(13,a[15]*(float)k/(float)td+b[15]);
      servo_write(14,a[16]*(float)k/(float)td+b[16]);
      servo_write(15,a[17]*(float)k/(float)td+b[17]);

      delay(dt);
  }
}

void rs_gets_3c(char gtc[4])
{
  char gc;
  int i;
 
    sprintf(gtc,"    ");
    for( i = 0 ; i < 4 ; i++ )
    {
      gc = SerialBT.read();
      if (gc == ',')
        break;
      else
        gtc[i] = gc;
    }
}

void setup() 
{ 
  M5.begin();
  M5.Power.begin();
  M5.IMU.Init();
  dacWrite(25,0);  //ノイズ対策

  M5.Lcd.println("Bluetooth Now");
  
  //Serial.begin(9600);
  SerialBT.begin("M5Stack");  //PC側で確認するときの名前

  Wire.begin();//I2C通信を開始する

  servo3.setPeriodHertz(50);      // Standard 50hz servo  (ESP32servo)
  servo4.setPeriodHertz(50);      // Standard 50hz servo  (ESP32servo)
    
  servo3.attach(servo3Pin, minUs, maxUs);  // ESP32servo
  servo4.attach(servo4Pin, minUs, maxUs);  // ESP32servo
  
  pwm.begin();                   //初期設定 (アドレス0x40用) (PCA9685)
  pwm.setPWMFreq(50);            //PWM周期を50Hzに設定 (アドレス0x40用) (PCA9685)

  // Lcd display Face
  M5.Lcd.fillScreen(YELLOW); //base
  M5.Lcd.fillTriangle(79, 0, 159, 79, 239, 0, BLACK); //
  M5.Lcd.fillCircle(79, 119, 24, BLACK); //right eye
  M5.Lcd.fillCircle(239, 119, 24, BLACK); //left eye
  M5.Lcd.fillCircle(159, 179, 30, RED); //mouse
  M5.Lcd.fillRect(129, 149, 61, 31, YELLOW); //mouse

  //initial servo angle
  for (int j=0; j <=17 ; j++){
      ang0[j] = angZero[j] + angHome[j];
  }
  for (int j=0; j <=17 ; j++){
      ang1[j] = angZero[j] + angHome[j];
  }
  servo_set();
} 
 
void loop() 
{   
    if(SerialBT.available()){
      delection = SerialBT.read();
      switch (delection) {
        case 70: // F FWD
          SerialBT.println("FWD") ; 
          forward_step();
        break;
        case 76: // L LEFT
          SerialBT.println("LEFT") ; 
          left_step();
        break;
        case 82: // R Right
          SerialBT.println("RIGHT") ; 
          right_step();
        break;
        case 66: // B Back
          SerialBT.println("BACK") ; 
          back_step();
        break;
        case 72: // H Left Side
          SerialBT.println("LEFT_SIDE") ; 
          left_side_step();
        break;
        case 77: // M Right Side
          SerialBT.println("RIGHT_SIDE") ; 
          right_side_step();
        break;
        case 68: //Data
          SerialBT.println("DATA") ;
          for (int i=0; i <=17; i++){
            rs_gets_3c(ang_c);
            ang_b[i] = atoi(ang_c);
            if ((ang_b[i] >= 0) && (ang_b[i] <=180))
              {
                ang0[i] = ang1[i];
                ang1[i] = ang_b[i];
              }
          }
          servo_set();
        break;
      }
    }
    servo_set();
    m5.update();
}
