#include <M5Stack.h>
#include <ESP32Servo.h>    //ESPservo
#include <Wire.h>          // I2C setting
#include <PCA9685.h>       //for PCA9685
#include "BluetoothSerial.h" //BluetoothSerial

BluetoothSerial SerialBT;

int angZero[] = {81,89,1,105,81,98,89,83,91,89,93,101,91,93,95,92,75,180};
int angHome[] = {-45,45,0,0,0,0,-37,52,20,0,0,-20,-52,37,0,0,0,0};
int ang0[18];
int ang1[18];
int ang_b[18];
char ang_c[18];
int ts=10;
int td=10;

// Forward Step
int f_s[40][18]={
  {-45,45,0,0,0,0,-39,52,20,0,0,-20,-52,39,0,0,0,0},
  {-45,45,0,0,0,-6,-38,50,19,-6,-6,-19,-50,38,-6,0,0,0},
  {-45,45,0,0,0,-9,-36,47,18,-9,-9,-18,-47,36,-9,0,0,0},
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  {-45,45,0,0,0,0,-39,52,20,0,0,-20,-52,39,0,0,0,0}};
// Left Step
int l_s[30][18]={
  {-45,45,0,0,0,0,-39,52,20,0,0,-20,-52,39,0,0,0,0},
  {-45,45,0,0,0,-6,-38,50,19,-6,-6,-19,-50,38,-6,0,0,0},
  {-45,45,0,0,0,-9,-36,47,18,-9,-9,-18,-47,36,-9,0,0,0},
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  {-45,45,0,0,0,0,-39,52,20,0,0,-20,-52,39,0,0,0,0}};
// Right Step
int r_s[30][18]={
  {-45,45,0,0,0,0,-39,52,20,0,0,-20,-52,39,0,0,0,0},
  {-45,45,0,0,0,6,-38,50,19,6,6,-19,-50,38,6,0,0,0},
  {-45,45,0,0,0,9,-36,47,18,9,9,-18,-47,36,9,0,0,0},
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  {-45,45,0,0,0,0,-39,52,20,0,0,-20,-52,39,0,0,0,0}};
// Back Step
int b_s[40][18]={
  {-45,45,0,0,0,0,-39,52,20,0,0,-20,-52,39,0,0,0,0},
  {-45,45,0,0,0,-6,-38,50,19,-6,-6,-19,-50,38,-6,0,0,0},
  {-45,45,0,0,0,-9,-36,47,18,-9,-9,-18,-47,36,-9,0,0,0},
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  {-45,45,0,0,0,0,-39,52,20,0,0,-20,-52,39,0,0,0,0}};
// Left Side Step
int ls_s[21][18]={
  {-45,45,0,0,0,0,-39,52,20,0,0,-20,-52,39,0,0,0,0},
  {-45,45,0,0,0,0,-55,76,28,0,0,-28,-76,55,0,0,0,0},
  {-45,45,0,0,0,-4,-54,75,28,-4,-4,-28,-75,54,-4,0,0,0},
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  {-45,45,0,0,0,0,-39,52,20,0,0,-20,-52,39,0,0,0,0}};
// Right Side Step
int rs_s[21][18]={
  {-45,45,0,0,0,0,-39,52,20,0,0,-20,-52,39,0,0,0,0},
  {-45,45,0,0,0,0,-55,76,28,0,0,-28,-76,55,0,0,0,0},
  {-45,45,0,0,0,4,-54,75,28,4,4,-28,-75,54,4,0,0,0},
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  {-45,45,0,0,0,0,-39,52,20,0,0,-20,-52,39,0,0,0,0}};
int delection = 0;

// create four servo objects (ESP32servo)
Servo servo3;
Servo servo4;

//PCA9685のアドレス指定
PCA9685 pwm = PCA9685(0x40);

// Published values for SG90 servos; adjust if needed (ESP32servo)
int minUs = 700;
int maxUs = 2300;

#define SERVOMIN 150            //Min pulse width (GWS Micro2BBMG) (PCA9685)
#define SERVOMAX 500            //Max pulse width (GWS Micro2BBMG) (PCA9685)

// These are all GPIO pins on the ESP32
// Recommended pins include 2,4,12-19,21-23,25-27,32-33
int servo3Pin = 12;  //ESP32servo
int servo4Pin = 13;  //ESP32servo

void setup() 
{ 
  M5.begin();
  dacWrite(25,0);  //for noise
  M5.Lcd.println("Bluetooth Now");
  
  Serial.begin(9600);
  SerialBT.begin("M5Stack");

  servo3.setPeriodHertz(50);      // Standard 50hz servo  (ESP32servo)
  servo4.setPeriodHertz(50);      // Standard 50hz servo  (ESP32servo)
    
  servo3.attach(servo3Pin, minUs, maxUs);  // ESP32servo
  servo4.attach(servo4Pin, minUs, maxUs);  // ESP32servo
  
  pwm.begin();                   //initial setting (for 0x40) (PCA9685)
  pwm.setPWMFreq(50);            //PWM 50Hz (for 0x40) (PCA9685)

  // Lcd display Face
  M5.Lcd.fillScreen(YELLOW); //base
  M5.Lcd.fillTriangle(79, 0, 159, 79, 239, 0, BLACK); //
  M5.Lcd.fillCircle(79, 119, 24, BLACK); //right eye
  M5.Lcd.fillCircle(239, 119, 24, BLACK); //left eye
  M5.Lcd.fillCircle(159, 179, 30, RED); //mouse
  M5.Lcd.fillRect(129, 149, 61, 31, YELLOW); //mouse

  //initial servo angle
  for (int j=0; j <=17 ; j++){
      ang0[j] = angZero[j] + angHome[j];
  }
  for (int j=0; j <=17 ; j++){
      ang1[j] = angZero[j] + angHome[j];
  }
  servo_set();
  
  Wire.begin();//start I2C
  
} 
 
void loop() 
{   
    if(SerialBT.available()){
      delection = SerialBT.read();
      switch (delection) {
        case 70: // F FWD
          SerialBT.println("FWD") ; 
          forward_step();
        break;
        case 76: // L LEFT
          SerialBT.println("LEFT") ; 
          left_step();
        break;
        case 82: // R Right
          SerialBT.println("RIGHT") ; 
          right_step();
        break;
        case 66: // B Back
          SerialBT.println("BACK") ; 
          back_step();
        break;
        case 72: // H Left Side
          SerialBT.println("LEFT_SIDE") ; 
          left_side_step();
        break;
        case 77: // M Right Side
          SerialBT.println("RIGHT_SIDE") ; 
          right_side_step();
        break;
        case 68: //Data
          SerialBT.println("DATA") ;
          for (int i=0; i <=17; i++){
            rs_gets_3c(ang_c);
            ang_b[i] = atoi(ang_c);
            if ((ang_b[i] >= 0) && (ang_b[i] <=180))
              {
                ang0[i] = ang1[i];
                ang1[i] = ang_b[i];
              }
          }
          servo_set();
        break;
      }
    }
    else{
          servo_set();
    }
} 

void servo_write(int ch, int ang){
  ang = map(ang, 0, 180, SERVOMIN, SERVOMAX); //angle（0～180）-> pulse width（150～500）
  pwm.setPWM(ch, 0, ang);
}

void forward_step()
{
  for (int i=0; i <=39 ; i++){
    for (int j=0; j <=17 ; j++){
      ang1[j] = angZero[j] + f_s[i][j];
    }
  servo_set();
  }
}

void left_step()
{
  for (int i=0; i <=29 ; i++){
    for (int j=0; j <=17 ; j++){
      ang1[j] = angZero[j] + l_s[i][j];
    }
  servo_set();
  }
}

void right_step()
{
  for (int i=0; i <=29 ; i++){
    for (int j=0; j <=17 ; j++){
      ang1[j] = angZero[j] + r_s[i][j];
    }
  servo_set();
  }
}

void back_step()
{
  for (int i=0; i <=39 ; i++){
    for (int j=0; j <=17 ; j++){
      ang1[j] = angZero[j] + b_s[i][j];
    }
  servo_set();
  }
}

void left_side_step()
{
  for (int i=0; i <=20 ; i++){
    for (int j=0; j <=17 ; j++){
      ang1[j] = angZero[j] + ls_s[i][j];
    }
  servo_set();
  }
}

void right_side_step()
{
  for (int i=0; i <=20 ; i++){
    for (int j=0; j <=17 ; j++){
      ang1[j] = angZero[j] + rs_s[i][j];
    }
  servo_set();
  }
}

void servo_set()
{
  int a[18],b[18];

  for (int j=0; j <=17 ; j++){
      a[j] = ang1[j] - ang0[j];
      b[j] = ang0[j];
      ang0[j] = ang1[j];
  }
  
  for (int k=0; k <=td ; k++){

      // ESP32servo

      servo3.write(a[0]*k/td+b[0]);
      servo4.write(a[1]*k/td+b[1]);

      // PCA9685
      servo_write(0,a[2]*k/td+b[2]);
      servo_write(1,a[3]*k/td+b[3]);
      servo_write(2,a[4]*k/td+b[4]);
      servo_write(3,a[5]*k/td+b[5]);
      servo_write(4,a[6]*k/td+b[6]);
      servo_write(5,a[7]*k/td+b[7]);
      servo_write(6,a[8]*k/td+b[8]);
      servo_write(7,a[9]*k/td+b[9]);
      servo_write(8,a[10]*k/td+b[10]);
      servo_write(9,a[11]*k/td+b[11]);
      servo_write(10,a[12]*k/td+b[12]);
      servo_write(11,a[13]*k/td+b[13]);
      servo_write(12,a[14]*k/td+b[14]);
      servo_write(13,a[15]*k/td+b[15]);
      servo_write(14,a[16]*k/td+b[16]);
      servo_write(15,a[17]*k/td+b[17]);

      delay(ts/td);
  }
}

void rs_gets_3c(char gtc[4])
{
  char gc;
  int i;
 
    sprintf(gtc,"    ");
    for( i = 0 ; i < 4 ; i++ )
    {
      gc = SerialBT.read();
      if (gc == ',')
        break;
      else
        gtc[i] = gc;
    }
}
